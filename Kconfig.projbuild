## components/lcm32/Kconfig
```kconfig
menu "LCM32 options"
    config LCM32_DRD_WINDOW_MS
        int "Double reset window (ms)"
        default 3000
        help
            Time window in milliseconds for detecting a double reset.
endmenu
```

## components/ota_lifecycle/Kconfig
```kconfig
menu "Lifecycle Manager component"

config LCM_LOG_TAG
    string "Log tag used by lifecycle manager"
    default "LCM"
    help
        Defines the tag used for ESP_LOG output.

config LCM_FACTORY_RESET_TRIGGER_COUNT
    int "Rapid restart threshold"
    range 1 100
    default 10
    help
        Number of consecutive rapid restarts that triggers the factory reset
        callback.

config LCM_FACTORY_RESET_COUNTDOWN_SECONDS
    int "Factory reset countdown seconds"
    range 0 60
    default 11
    help
        Optional countdown that runs once the rapid restart threshold is
        reached. A value of 0 disables the countdown.

config LCM_RESTART_COUNTER_TIMEOUT_MS
    int "Restart counter timeout window (ms)"
    range 1000 3600000
    default 5000
    help
        Duration without a reset after which the consecutive restart counter is
        cleared automatically.

config LCM_RESTART_COUNTER_NAMESPACE
    string "NVS namespace for lifecycle data"
    default "lcm"
    help
        Namespace in NVS where the restart counter is stored.

config LCM_RESTART_COUNTER_KEY
    string "NVS key for restart counter"
    default "restart_count"
    help
        Key used inside the lifecycle namespace to persist the restart counter.

endmenu
```

## examples/led/main/Kconfig.projbuild
```kconfig
menu "StudioPieters"

      config ESP_LED_GPIO
              int "Set the GPIO for the LED"
              default 2
              help
                  The GPIO number the LED is connected to.

      config ESP_BUTTON_GPIO
              int "Button GPIO"
              default 32
              help
                  GPIO van de knop (actief laag als je button_config_default(button_active_low) gebruikt).

      config ESP_SETUP_CODE
              string "HomeKit Setup Code"
              default "338-77-883"
              help
                  If you want to change the HomeKit Setup Code, you can do that here (Note:  you need to make a new QR-CODE To make it work)

      config ESP_SETUP_ID
              string "HomeKit Setup ID"
              default "1QJ8"
              help
                   If you want to change the HomeKit Setup ID, you can do that here (Note: you need to make a new QR-CODE To make it work)

      config LCM_RESTART_COUNTER_TIMEOUT_MS
              int "Restart counter auto-reset timeout (ms)"
              default 0
              range 0 600000
              help
                  Hoe lang (in milliseconden) het apparaat aan moet blijven voordat
                  de automatische reset van de power-cycle teller plaatsvindt.
                  Kies 0 om de teller niet automatisch te wissen zodat 10-12
                  power-cycles altijd een fabrieksreset afdwingen.

endmenu
```
