## main/Kconfig.projbuild
```kconfig
menu "StudioPieters"

config ESP_LED_GPIO
    int "Set the GPIO for the LED"
    default 2
    help
        The GPIO number the LED is connected to.

config WIFI_CONFIG_RESTART_ON_DISCONNECT
    bool "Restart when WiFi is disconnected"
    default n
    help
        Enable this option to reboot the device if the WiFi connection is lost.

config LCM_RESTART_COUNTER_TIMEOUT_MS
    int "Restart counter timeout window (ms)"
    range 1000 3600000
    default 10000
    help
        Defines how long the device waits for another restart before the
        consecutive restart counter is reset.

config LCM_VERBOSE_OTA_LOG
    bool "Verbose OTA/HTTP debug logging"
    default n
    help
        Raise the log level of the OTA, esp_https_ota and HTTP client tags to
        DEBUG. This is useful for field diagnostics but is noisy and logs the
        firmware download URLs, so it is disabled by default.

config LCM_REQUIRE_NVS_ENCRYPTION
    bool "Require NVS encryption at runtime"
    default n
    help
        If enabled, startup aborts unless ESP-IDF NVS encryption is enabled
        in sdkconfig (`CONFIG_NVS_ENCRYPTION`).


config LCM_USE_CUSTOM_OTA_PUBLIC_KEY
    bool "Use custom OTA signing public key"
    default n
    help
        Enable to override the built-in demo OTA signing public key.

config LCM_ALLOW_INSECURE_DEMO_KEY
    bool "Allow building with the public demo OTA signing key (INSECURE)"
    depends on !LCM_USE_CUSTOM_OTA_PUBLIC_KEY
    default n
    help
        The built-in default OTA public key has a matching private key that is
        published in this repository (keys/ota_signing_private.pem). Anyone can
        therefore sign firmware that a device built with the demo key will
        accept, so OTA signing provides no real authenticity in this mode.

        To prevent shipping this insecure default by accident, the build fails
        unless you either provide your own key via LCM_USE_CUSTOM_OTA_PUBLIC_KEY
        or explicitly acknowledge the risk by enabling this option. Never enable
        this in production.

config LCM_CUSTOM_OTA_PUBLIC_KEY_PEM
    string "Custom OTA public key (PEM, single-line with \n escapes)"
    depends on LCM_USE_CUSTOM_OTA_PUBLIC_KEY
    default ""
    help
        PEM encoded ECDSA P-256 public key used for OTA signature
        verification. Use \n for line breaks.

endmenu
```
